// SPDX-License-Identifier: (GPL-2.0 OR MIT)
/*
 * Copyright 2020 Compass Electronic Solutions
 */

/dts-v1/;

#include "fsl-imx8mn.dtsi"
#include "beacon-imx8mn-som.dtsi"
#include "beacon-imx8mn-baseboard.dtsi"

/ {
	model = "Beacon EmbeddedWorks i.MX8M Nano Development Kit";
	compatible = "fsl,imx8mn";

	chosen {
		stdout-path = &uart2;
	};
};
