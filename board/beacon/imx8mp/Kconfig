## board/beacon/imx8mp/Kconfig
```kconfig
if TARGET_IMX8MP_BEACON

config SYS_BOARD
	default "imx8mp"

config SYS_VENDOR
	default "beacon"

config SYS_CONFIG_NAME
	default "imx8mp_beacon"

config IMX8MP_BEACON_4GB_LPDDR
	bool "Enable 4GB LPDDR"
	help
	  Enable this if the SOM has 4GB of RAM instead of
	  the default 6GB variant.

config IMX8MP_BEACON_2GB_LPDDR
	bool "Enable 2GB LPDDR"
	help
	  Enable this if the SOM has 2GB of RAM instead of
	  the default 6GB variant.

config IMX_CONFIG
	default "board/freescale/imx8mp_evk/imximage-8mp-lpddr4.cfg"

source "board/freescale/common/Kconfig"

endif
```

## board/beacon/imx93/Kconfig
```kconfig
if TARGET_IMX93_BEACON

config SYS_BOARD
	default "imx93"

config SYS_VENDOR
	default "beacon"

config SYS_CONFIG_NAME
	default "imx93_beacon"

choice
	prompt "Select method to choose LPDDR4x timing for TARGET_IMX93_BEACON"
	default BEACON_IMX93_LPDDR4X_TIMING_BY_NAME

config BEACON_IMX93_LPDDR4X_TIMING_BY_NAME
	bool "Using BEACON_IMX93_LPDDR4X_TIMING_FILENAME for LPDDR4x Timing selection"
	help
	  Select the LPDDR4x timing based on specified filename

config BEACON_IMX93_LPDDR4X_TIMING_BY_BOARD_ID
	bool "Using Beacon HW Board ID for LPDDR4x Timing selection"
	help
	  Select the LPDDR4x timing based on Board ID

config BEACON_IMX93_LPDDR4X_TIMING_BY_EEPROM
	bool "Using Beacon EEPROM contents for LPDDR4x Timing selection"
	help
	  Select the LPDDR4x timing based on contents of EEPROM on SOM

endchoice

config BEACON_IMX93_LPDDR4X_TIMING_FILENAME
	string "Specify the LPDDR4x Timing Filename"
    depends on BEACON_IMX93_LPDDR4X_TIMING_BY_NAME
	default "lpddr4x_1gbyte_timing"
	help
	  Name of the timing file to use when BEACON_IMX93_LPDDR4X_TIMING_BY_NAME is used.


endif
```

## board/cargt/imx8mp_00377/Kconfig
```kconfig
if TARGET_IMX8MP_00377

config SYS_BOARD
	default "imx8mp_00377"

config SYS_VENDOR
	default "cargt"

config SYS_CONFIG_NAME
	default "imx8mp_00377"

config IMX_CONFIG
	default "board/cargt/imx8mp_00377/imximage-8mp-lpddr4.cfg"

endif
```

## board/cargt/imx93_00359/Kconfig
```kconfig
if TARGET_IMX93_00359

config SYS_BOARD
	default "imx93_00359"

config SYS_VENDOR
	default "cargt"

config SYS_CONFIG_NAME
	default "imx93_00359"

choice
	prompt "Select method to choose LPDDR4x timing for TARGET_IMX93_00359"
	default CARGT_IMX93_00359_LPDDR4X_TIMING_BY_NAME

config CARGT_IMX93_00359_LPDDR4X_TIMING_BY_NAME
	bool "Using CARGT_IMX93_00359_LPDDR4X_TIMING_FILENAME for LPDDR4x Timing selection"
	help
	  Select the LPDDR4x timing based on specified filename

config CARGT_IMX93_00359_LPDDR4X_TIMING_BY_BOARD_ID
	bool "Using Cargt HW Board ID for LPDDR4x Timing selection"
	help
	  Select the LPDDR4x timing based on Board ID

config CARGT_IMX93_00359_LPDDR4X_TIMING_BY_EEPROM
	bool "Using Cargt EEPROM contents for LPDDR4x Timing selection"
	help
	  Select the LPDDR4x timing based on contents of EEPROM on SOM

endchoice

config CARGT_IMX93_00359_LPDDR4X_TIMING_FILENAME
	string "Specify the LPDDR4x Timing Filename"
    depends on CARGT_IMX93_00359_LPDDR4X_TIMING_BY_NAME
	default "cargt_lpddr4x_1gbyte_timing"
	help
	  Name of the timing file to use when CARGT_IMX93_00359_LPDDR4X_TIMING_BY_NAME is used.


endif
```
